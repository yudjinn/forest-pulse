## mcu/main/Kconfig.projbuild
```kconfig
menu "Acoustic Front-End"

    choice FE_SOURCE
        prompt "Audio source"
        default FE_SOURCE_MICS
        config FE_SOURCE_MICS
            bool "ICS-43434 mics (I2S0 clocks + LCD_CAM bit capture)"
        config FE_SOURCE_SYNTH
            bool "Synthetic test source (frame index on ch2/ch3)"
    endchoice

    config FE_SAMPLE_RATE_HZ
        int "Sample rate (Hz)"
        default 48000
        help
            Must be a multiple of 50 so a 20 ms block is a whole number of frames.

    config FE_RING_MS
        int "PSRAM ring buffer length (ms)"
        default 6000
        help
            6 s x 48 kHz x 6 B = 1,728,000 B; fits the 2 MB PSRAM.

    config FE_PRE_TRIGGER_MS
        int "Pre-trigger window sent on event (ms)"
        default 4000
        help
            Ring length minus this is the time the host has to start reading
            after WAKE before audio is lost.

    config FE_USB_TX_BUF_BYTES
        int "USB-Serial/JTAG driver TX buffer (bytes)"
        default 16384

    menu "Trigger"

        config FE_TRIG_SNR_DB
            int "RMS gate: dB above adaptive noise floor"
            default 6

        config FE_TRIG_BAND_RATIO_DB
            int "Spectral gate: mean band power over 50 Hz wind bin (dB)"
            default 3

        config FE_TRIG_ARM_BLOCKS
            int "Consecutive positive 20 ms blocks to trigger"
            default 5

        config FE_TRIG_COOLDOWN_MS
            int "Quiet time that ends an event (ms)"
            default 2000

        config FE_EVENT_MAX_POST_MS
            int "Maximum live streaming after the trigger (ms)"
            default 15000

        config FE_TRIG_FLOOR_TAU_S
            int "Noise floor rise time constant (s)"
            default 20

        config FE_TRIG_FLOOR_LONG_TAU_S
            int "Floor rise on persistent sound while re-arming (s)"
            default 45
            help
                After an event, blocks that still trigger also pull the floor
                up with this time constant, so steady sounds become background.

        config FE_TRIG_COHERENCE_PCT
            int "Coherence gate: min inter-mic coherence, percent (0 = off)"
            default 50
            range 0 99
            help
                Mean magnitude-squared coherence between mic pairs over
                1-3 kHz. Distant point sources score near 100; wind, rain and
                diffuse room noise score low. Ignored with the synthetic source.

        config FE_TRIG_COHERENCE_TAU_MS
            int "Coherence averaging time constant (ms)"
            default 200

    endmenu

endmenu
```
